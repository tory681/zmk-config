## config/boards/shields/purpledactyl/Kconfig.shield
```kconfig
config SHIELD_PURPLEDACTYL_LEFT
    def_bool $(shields_list_contains, purpledactyl_left)

config SHIELD_PURPLEDACTYL_RIGHT
    def_bool $(shields_list_contains, purpledactyl_right)
```

## config/boards/shields/purpledactyl_right/Kconfig.defconfig
```kconfig
# Copyright (c) 2021 The ZMK Contributors
# SPDX-License-Identifier: MIT
if SHIELD_PURPLEDACTYL_LEFT

config ZMK_KEYBOARD_NAME
    default "PurpleDactyl"

config ZMK_SPLIT_ROLE_CENTRAL
    default y

endif

if SHIELD_PURPLEDACTYL_LEFT || SHIELD_PURPLEDACTYL_RIGHT

config ZMK_SPLIT
    default y

endif
```
